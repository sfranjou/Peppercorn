/* GENERATED by scripts/nds_ui/stock_api.py --write. Stock routine addresses for C code
   linked into the NDS UI segment; checked against stock_api.json by the nds_ui gate. */
link_post = 0x4650e;
heap_alloc = 0x5cfb0;
heap_free = 0x5cfd8;
link_mode_set = 0x46622;
link_pace = 0x467a2;
slot_notice_apply = 0x46c9a;
irq_guard_enter = 0x5c0e2;
irq_guard_leave = 0x5c102;
link_queue_produce = 0x15480;
legacy_load_send = 0x46262;
link_release_owned = 0x1573e;
host_reply_serialize = 0x40942;
gui_link_receive_tick = 0x46a0a;
effect_ordinal = 0x475d0;
lv_obj_create = 0x293e0;
strip_label_show = 0x293fc;
lv_obj_set_pos = 0x2a46a;
lv_obj_set_size = 0x2a4ce;
lv_obj_remove_style = 0x2d03e;
lv_obj_set_style_bg_color = 0x2d886;
lv_obj_set_style_bg_opa = 0x2d896;
lv_obj_set_style_radius = 0x2d9b6;
lv_obj_get_child = 0x2da52;
lv_obj_del = 0x2dbb4;
lv_bar_set_value = 0x3da4c;
lv_bar_set_range = 0x3db20;
lv_label_create = 0x3e78e;
lv_label_set_text = 0x3eea0;
lv_bar_create = 0x4076a;
mod026_restore_ctx = 0x16e39c;
enable_get = 0x452ae;
select_apply = 0x453d0;
effect_count = 0x43996;
effect_id_for = 0x439b6;
footswitch_toggle = 0x4586a;
preset_name_text = 0x472b8;
mod026_set_text = 0x16e52c;
mod026_editor_tick = 0x16e948;
stock_queue_receive = 0x5ced2;
stock_audio_notification = 0x49d7a;
stock_fatal = 0xd0b02;
stock_reset_tail = 0x4a070;
SECTIONS { . = 0x170000; .text : { *(.text*) *(.rodata*) } /DISCARD/ : { *(.comment) *(.note*) } }
